## buildroot/package/alientek/Config.in
```kconfig
menuconfig BR2_PACKAGE_ALIENTEK
    bool "alientek software developer's kit"
    default n

source "package/alientek/atk_installs/Config.in"
source "package/alientek/qt_demo/systemui/Config.in"
```

## buildroot/package/alientek/atk_installs/Config.in
```kconfig
if BR2_PACKAGE_ALIENTEK
config BR2_PACKAGE_ATK_INSTALLS
        bool "alientek installs"
        default n
        help
            alientek installs

endif #BR2_PACKAGE_ATK_INSTALLS
```

## buildroot/package/alientek/qt_demo/systemui/Config.in
```kconfig
if BR2_PACKAGE_ALIENTEK
config BR2_PACKAGE_SYSTEMUI
        bool "alientek systemui qt demo"
        depends on BR2_PACKAGE_QT5
        depends on BR2_PACKAGE_QT5BASE
        depends on BR2_PACKAGE_QT5DECLARATIVE
        depends on BR2_PACKAGE_QT5MULTIMEDIA
        depends on BR2_PACKAGE_QT5VIRTUALKEYBOARD
        depends on BR2_PACKAGE_QT5REMOTEOBJECTS
	depends on BR2_PACKAGE_ATK_INSTALLS
        depends on BR2_PACKAGE_ALIENTEK

        help
          ALIENTEK Qt Demo application based on QT

endif
```

## buildroot/package/python-ruamel-yaml-clib/Config.in
```kconfig
config BR2_PACKAGE_PYTHON_RUAMEL_YAML_CLIB
	bool "python-ruamel-yaml-clib"
	help
	ruamel.yaml.clib is the C based reader/scanner and emitter for ruamel.yaml

	  https://pypi.org/project/ruamel.yaml.clib
```

## buildroot/package/rockchip/fibocom_dial_tool/Config.in
```kconfig
config BR2_PACKAGE_FIBOCOM_DIAL_TOOL
	bool "Fibocom-dial TooL for USB and PCIE of FIBOCOM wireless cellular modules"
	default y
	help
	  Fibocom QMI Dial-up Tool.
```
